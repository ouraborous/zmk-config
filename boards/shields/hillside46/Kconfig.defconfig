## boards/shields/hillside46/Kconfig.defconfig
```kconfig
# Copyright (c) 2021-2022 The ZMK Contributors
# SPDX-License-Identifier: MIT

if SHIELD_HILLSIDE46_LEFT

config ZMK_KEYBOARD_NAME
    default "Hillside46"

config ZMK_SPLIT_ROLE_CENTRAL
    default y

endif

if SHIELD_HILLSIDE46_LEFT || SHIELD_HILLSIDE46_RIGHT || SHIELD_HILLSIDE46_DONGLE

config ZMK_SPLIT
    default y

endif

if SHIELD_HILLSIDE46_DONGLE

if ZMK_DISPLAY

config I2C
    default y

config SSD1306
    default y

choice ZMK_DISPLAY_WORK_QUEUE
    default ZMK_DISPLAY_WORK_QUEUE_DEDICATED
endchoice

if LVGL

config LV_Z_VDB_SIZE
    default 64

config LV_DPI_DEF
    default 148

config LV_Z_BITS_PER_PIXEL
    default 1

choice LV_COLOR_DEPTH
    default LV_COLOR_DEPTH_1
endchoice

endif # LVGL

endif # ZMK_DISPLAY

# Max 16 characters in keyboard name
config ZMK_KEYBOARD_NAME
    default "Hillside46 Dngl"

config ZMK_SPLIT_ROLE_CENTRAL
    default y

# Set this to the number of peripherals your dongle will have.
# For a unibody, this would be 1. If you have left and right halves, set it to 2, etc.
config ZMK_SPLIT_BLE_CENTRAL_PERIPHERALS
    default 2

# Set this to ZMK_SPLIT_BLE_CENTRAL_PERIPHERALS + your desired number of BT profiles (default is 5)
config BT_MAX_CONN
    default 6

# Set this to the same number as BT_MAX_CONN
config BT_MAX_PAIRED
    default 6

endif
```

## config/west.yml
```yaml
manifest:
  defaults:
    revision: v0.2 # Pin everything to v0.2
  remotes:
    - name: zmkfirmware
      url-base: https://github.com/zmkfirmware
    - name: urob
      url-base: https://github.com/urob
  projects:
    - name: zmk
      remote: zmkfirmware
      revision: main
      import: app/west.yml
    - name: zmk-helpers
      remote: urob
      path: modules/zmk/helpers
  self:
    path: config
```
